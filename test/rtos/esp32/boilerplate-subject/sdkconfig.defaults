## test/rtos/esp32/components/mc-coap/Kconfig
```kconfig
# DEBT: Only exists within test area

menu "EMBR: CoAP"

    config EMBR_COAP_RTC_RESTART_COUNTER
        default y
        bool "RTC system restart counter"

endmenu
```

## test/rtos/esp32/echo-subject/main/Kconfig.projbuild
```kconfig
# Lifted from https://github.com/espressif/esp-idf/blob/v5.0/examples/wifi/espnow/main/Kconfig.projbuild

menu "echo-subject"

    config ESPNOW_PMK
        string "ESPNOW primary master key"
        default "pmk1234567890123"
        help
            ESPNOW primary master for the example to use. The length of ESPNOW primary master must be 16 bytes.

    config ESPNOW_CHANNEL
        int "esp-now channel"
        default 1
        range 0 14
        help
            The channel on which sending and receiving ESPNOW data.

    config ESPNOW_SEND_COUNT
        int "Send count"
        default 100
        range 1 65535
        help
            Total count of unicast ESPNOW data to be sent.

    config ESPNOW_SEND_DELAY
        int "Send delay"
        default 1000
        range 0 65535
        help
            Delay between sending two ESPNOW data, unit: ms.

    config ESPNOW_SEND_LEN
        int "Send len"
        range 10 250
        default 10
        help
            Length of ESPNOW data to be sent, unit: byte.

    config ESPNOW_ENABLE_LONG_RANGE
        bool "Enable Long Range"
        default "n"
        help
            When enable long range, the PHY rate of ESP32 will be 512Kbps or 256Kbps
            
endmenu
```

## test/rtos/esp32/peripheral/main/Kconfig.projbuild
```kconfig
menu "CoAP Peripheral"

    config MDNS_INSTANCE_NAME
        string "mDNS full human readable name of app instance"
        default "CoAP peripheral application"

    config MDNS_COAP_SERVICE_NAME
        string "mDNS name of CoAP service"
        default "CoAP peripheral control"

endmenu
```

## test/rtos/esp32/unity/sdkconfig.defaults
```kconfig
# MAY be needed for retry/loopback tests, not proven
#CONFIG_LWIP_TCPIP_CORE_LOCKING=y
```
